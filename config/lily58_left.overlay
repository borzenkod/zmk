/ {
        right_encoder: right_encoder {
                compatible = "alps,ec11";
                a-gpios = <&pro_micro 21 (GPIO_ACTIVE_HIGH | GPIO_PULL_UP)>;
                b-gpios = <&pro_micro 20 (GPIO_ACTIVE_HIGH | GPIO_PULL_UP)>;
                steps = <80>;
                status = "disabled";
        };
        left_encoder: encoder_left {
                compatible = "alps,ec11";
                a-gpios = <&pro_micro 21 (GPIO_ACTIVE_HIGH | GPIO_PULL_UP)>;
                b-gpios = <&pro_micro 20 (GPIO_ACTIVE_HIGH | GPIO_PULL_UP)>;
                steps = <80>;
                status = "okay";
        };
};
